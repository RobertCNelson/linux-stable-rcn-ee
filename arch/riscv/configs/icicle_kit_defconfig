## arch/riscv/configs/icicle_kit_defconfig
```kconfig
CONFIG_SYSVIPC=y
CONFIG_POSIX_MQUEUE=y
CONFIG_NO_HZ_IDLE=y
CONFIG_HIGH_RES_TIMERS=y
CONFIG_IKCONFIG=y
CONFIG_IKCONFIG_PROC=y
CONFIG_CGROUPS=y
CONFIG_CGROUP_SCHED=y
CONFIG_CFS_BANDWIDTH=y
CONFIG_CGROUP_BPF=y
CONFIG_NAMESPACES=y
CONFIG_USER_NS=y
CONFIG_BLK_DEV_INITRD=y
CONFIG_EXPERT=y
CONFIG_KALLSYMS_ALL=y
CONFIG_BPF_SYSCALL=y
CONFIG_SOC_MICROCHIP_POLARFIRE=y
CONFIG_SMP=y
CONFIG_CMDLINE="earlyprintk debug uio_pdrv_genirq.of_id=generic-uio"
CONFIG_JUMP_LABEL=y
CONFIG_MODULES=y
CONFIG_MODULE_UNLOAD=y
CONFIG_BLK_DEV_ZONED=y
CONFIG_PARTITION_ADVANCED=y
CONFIG_NET=y
CONFIG_PACKET=y
CONFIG_UNIX=y
CONFIG_INET=y
CONFIG_NETLINK_DIAG=y
CONFIG_PCI=y
CONFIG_PCI_DEBUG=y
CONFIG_PCI_HOST_GENERIC=y
CONFIG_PCIE_MICROCHIP_HOST=y
CONFIG_DEVTMPFS=y
CONFIG_DEVTMPFS_MOUNT=y
CONFIG_BLK_DEV_LOOP=y
CONFIG_BLK_DEV_NBD=y
CONFIG_BLK_DEV_NVME=y
CONFIG_BLK_DEV_SD=y
CONFIG_BLK_DEV_SR=y
CONFIG_ATA=y
CONFIG_NETDEVICES=y
CONFIG_MACB=y
CONFIG_R8169=y
CONFIG_INPUT_MOUSEDEV=y
CONFIG_INPUT_EVDEV=y
CONFIG_SERIAL_8250=y
CONFIG_SERIAL_8250_CONSOLE=y
CONFIG_SERIAL_OF_PLATFORM=y
CONFIG_SERIAL_EARLYCON_RISCV_SBI=y
CONFIG_HW_RANDOM=y
CONFIG_HW_RANDOM_POLARFIRE_SOC=y
CONFIG_I2C_CHARDEV=y
CONFIG_I2C_MICROCHIP=y
CONFIG_SPI=y
CONFIG_SPI_MICROSEMI=y
CONFIG_SPI_MICROSEMI_QSPI=y
CONFIG_SPI_SPIDEV=y
CONFIG_GPIOLIB=y
CONFIG_GPIO_SYSFS=y
CONFIG_GPIO_MICROSEMI=y
CONFIG_POWER_RESET=y
CONFIG_MEDIA_SUPPORT=y
CONFIG_MEDIA_USB_SUPPORT=y
CONFIG_USB_VIDEO_CLASS=y
CONFIG_V4L_PLATFORM_DRIVERS=y
CONFIG_DRM=y
CONFIG_DRM_RADEON=y
CONFIG_DRM_NOUVEAU=y
CONFIG_FRAMEBUFFER_CONSOLE=y
CONFIG_USB=y
CONFIG_USB_XHCI_HCD=y
CONFIG_USB_XHCI_PLATFORM=y
CONFIG_USB_EHCI_HCD=y
CONFIG_USB_EHCI_HCD_PLATFORM=y
CONFIG_USB_OHCI_HCD=y
CONFIG_USB_OHCI_HCD_PLATFORM=y
CONFIG_USB_ACM=y
CONFIG_USB_STORAGE=y
CONFIG_USB_MUSB_HDRC=y
CONFIG_USB_MUSB_MPFS_MICROCHIP=y
CONFIG_USB_INVENTRA_DMA=y
CONFIG_USB_SERIAL=y
CONFIG_NOP_USB_XCEIV=y
CONFIG_MMC=y
CONFIG_MMC_SDHCI=y
CONFIG_MMC_SDHCI_PLTFM=y
CONFIG_MMC_SDHCI_CADENCE=y
CONFIG_MMC_SPI=y
CONFIG_RTC_CLASS=y
CONFIG_RTC_DRV_MPFS=y
CONFIG_DMADEVICES=y
CONFIG_SF_PDMA=y
CONFIG_UIO=y
CONFIG_UIO_PDRV_GENIRQ=y
CONFIG_UIO_DMEM_GENIRQ=y
CONFIG_UIO_MICROCHIP_CAN=y
CONFIG_UIO_MICROCHIP_PDMA=y
CONFIG_UIO_MICROSEMI_DMA=y
CONFIG_MAILBOX=y
CONFIG_POLARFIRE_SOC_MAILBOX=y
CONFIG_POLARFIRE_SOC_SYS_CTRL=y
CONFIG_POLARFIRE_SOC_GENERIC_SERVICE=y
CONFIG_IIO=y
CONFIG_IIO_SW_DEVICE=y
CONFIG_IIO_SW_TRIGGER=y
CONFIG_PAC193X=y
CONFIG_PWM=y
CONFIG_PWM_MICROCHIP_CORE=y
CONFIG_EXT4_FS=y
CONFIG_EXT4_FS_POSIX_ACL=y
CONFIG_FANOTIFY=y
CONFIG_MSDOS_FS=y
CONFIG_VFAT_FS=y
CONFIG_FAT_DEFAULT_IOCHARSET="ascii"
CONFIG_EXFAT_FS=y
CONFIG_TMPFS=y
CONFIG_TMPFS_POSIX_ACL=y
CONFIG_NFS_FS=y
CONFIG_NFS_V4=y
CONFIG_NFS_V4_1=y
CONFIG_NFS_V4_2=y
CONFIG_NLS_CODEPAGE_437=y
CONFIG_NLS_CODEPAGE_850=y
CONFIG_NLS_ASCII=y
CONFIG_NLS_ISO8859_1=y
CONFIG_NLS_UTF8=y
CONFIG_PRINTK_TIME=y
CONFIG_SCHED_STACK_END_CHECK=y
CONFIG_SOFTLOCKUP_DETECTOR=y
CONFIG_WQ_WATCHDOG=y
CONFIG_SCHEDSTATS=y
CONFIG_DEBUG_SPINLOCK=y
CONFIG_STACKTRACE=y
```

## drivers/accel/thames/Kconfig
```kconfig
# SPDX-License-Identifier: GPL-2.0-only

config DRM_ACCEL_THAMES
	tristate "Thames (support for TI C7x DSP accelerators)"
	depends on DRM_ACCEL
	depends on TI_K3_R5_REMOTEPROC || COMPILE_TEST
	depends on RPMSG
	depends on MMU
	select DRM_SCHED
	select DRM_GEM_SHMEM_HELPER
	help
	  Choose this option if you have a Texas Instruments SoC that contains
	  C7x DSP cores that can be used as compute accelerators. This includes
	  SoCs such as the AM62A, J721E, J721S2, and J784S4.

	  The C7x DSP cores can be used for general-purpose compute acceleration
	  and are exposed through the DRM accel subsystem.

	  The interface exposed to userspace is described in
	  include/uapi/drm/thames_accel.h and is used by the Thames userspace
	  driver in Mesa3D.

	  If unsure, say N.

	  To compile this driver as a module, choose M here: the
	  module will be called thames.
```

## drivers/clk/microchip/Kconfig
```kconfig
# SPDX-License-Identifier: GPL-2.0

config MCHP_CLK_MPFS
	bool "Clk driver for PolarFire SoC"
	depends on (RISCV && SOC_MICROCHIP_POLARFIRE) || COMPILE_TEST
	help
	  Supports Clock Configuration for PolarFire SoC
```

## drivers/crypto/microchip/Kconfig
```kconfig
#
# Microchip Crypto drivers configuration
#

config CRYPTO_DEV_POLARFIRE_SOC
	tristate "Microchip PolarFire SoC User cryptographic engine driver"
	depends on RISCV_SBI
	depends on SOC_MICROCHIP_POLARFIRE || COMPILE_TEST
	select CRYPTO_ENGINE
	select CRYPTO_AES
	select CRYPTO_SKCIPHER
	default y
	help
	  Support for Microchip PolarFire SoC User crypto engine.
	  This module provides acceleration for skcipher functions.

	  If you choose 'M' here, this module will be called microchip-crypto.

	  If unsure, say N.
```

## drivers/gpu/drm/imagination/Kconfig
```kconfig
# SPDX-License-Identifier: GPL-2.0 OR MIT
# Copyright (c) 2022 Imagination Technologies Ltd.

config DRM_POWERVR
	tristate "Imagination Technologies PowerVR Graphics"
	depends on ARM64
	depends on DRM
	select FW_LOADER
	help
	  Choose this option if you have a system that has an Imagination
	  Technologies PowerVR Rogue GPU.
```

## drivers/media/platform/microchip/Kconfig
```kconfig
# SPDX-License-Identifier: GPL-2.0
config VIDEO_MCHP_DSCMI
	tristate "Microchip Digital Serial Camera Memory Interface Driver"
	depends on V4L_PLATFORM_DRIVERS
	depends on VIDEO_DEV && OF
	select VIDEOBUF2_DMA_CONTIG
	select MEDIA_CONTROLLER
	select VIDEO_V4L2_SUBDEV_API
	select V4L2_FWNODE
	help
	  Microchip Digital Serial Camera Memory Interface Driver Support For Smart Embedded Vision Kit.
```

## drivers/misc/mikrobus/Kconfig
```kconfig
menuconfig MIKROBUS
	tristate "Module for instantiating devices on mikroBUS ports"
	help
	  This option enables the mikroBUS driver. mikroBUS is an add-on
	  board socket standard that offers maximum expandability with
	  the smallest number of pins. The mikroBUS driver helps in
	  instantiating devices on the mikroBUS port with identifier
	  data fetched from an EEPROM on the device.

	  Say Y here to enable support for this driver.

	  To compile this code as a module, chose M here: the module
	  will be called mikrobus.ko
```

## drivers/power/pwrseq/Kconfig
```kconfig
#
# Power Sequence library
#

config POWER_SEQUENCE
	bool

menu "Power Sequence Support"

config PWRSEQ_GENERIC
	bool "Generic power sequence control"
	depends on OF
	select POWER_SEQUENCE
	help
	   It is used for drivers which needs to do power sequence
	   (eg, turn on clock, toggle reset gpio) before the related
	   devices can be found by hardware. This generic one can be
	   used for common power sequence control.
endmenu
```

## drivers/soc/microchip/Kconfig
```kconfig
config POLARFIRE_SOC_SYS_CTRL
	tristate "POLARFIRE_SOC_SYS_CTRL"
	depends on POLARFIRE_SOC_MAILBOX
	help
	  This driver adds support for the PolarFire SoC (MPFS) system controller.

	  To compile this driver as a module, choose M here. the
	  module will be called mpfs_system_controller.

	  If unsure, say N.

config POLARFIRE_SOC_SERIAL_NUMBER
	tristate "PFSOC Serial Number"
	depends on POLARFIRE_SOC_SYS_CTRL
	help
	  This driver adds support for retrieving the PolarFire SoC's serial number via a char device.

config POLARFIRE_SOC_FPGA_DIGEST
	tristate "PFSOC FPGA Digest"
	depends on POLARFIRE_SOC_SYS_CTRL
	help
	  This driver adds support for retrieving the PolarFire SoC's fpga digest via a char device.

config POLARFIRE_SOC_SIGNATURE
	tristate "PFSOC FPGA Signature"
	depends on POLARFIRE_SOC_SYS_CTRL
	help
	  This driver adds support for signing a P-384 hash via a char device.

config POLARFIRE_SOC_FPGA_CERT
	tristate "PFSOC FPGA Device Cert"
	depends on POLARFIRE_SOC_SYS_CTRL
	help
	  This driver adds support for retrieving the PolarFire SoC's device supply chain x509 certificate via a char device.
```

## drivers/soc/sifive/Kconfig
```kconfig
# SPDX-License-Identifier: GPL-2.0

if SOC_SIFIVE || SOC_MICROCHIP_POLARFIRE

config SIFIVE_CCACHE
	bool "Sifive Composable Cache controller"
	select RISCV_DMA_NONCOHERENT
	help
	  Support for the composable cache controller on SiFive platforms.

endif
```
