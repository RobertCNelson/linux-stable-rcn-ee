/*
 * Samsung's Exynos3250 based ARTIK5 development board device tree source
 *
 * Copyright (c) 2016 Samsung Electronics Co., Ltd.
 *		http://www.samsung.com
 *
 * Device tree source file for Samsung's ARTIK5 development board
 * which is based on Samsung Exynos3250 SoC.
 *
 * This program is free software; you can redistribute it and/or modify
 * it under the terms of the GNU General Public License version 2 as
 * published by the Free Software Foundation.
 */

/dts-v1/;
#include "exynos3250-artik5.dtsi"

/ {
	model = "Samsung ARTIK5 development board";
	compatible = "samsung,artik5-devel", "samsung,artik5",
			"samsung,exynos3250", "samsung,exynos3";
};

&serial_2 {
	status = "okay";
};
