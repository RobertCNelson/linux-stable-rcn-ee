## Documentation/devicetree/bindings/rng/microchip,mpfs-rng.yaml
```yaml
# SPDX-License-Identifier: (GPL-2.0-only OR BSD-2-Clause)
%YAML 1.2
---
$id: "http://devicetree.org/schemas/rng/microchip,mpfs-rng.yaml#"
$schema: "http://devicetree.org/meta-schemas/core.yaml#"

title: Microchip MPFS random number generator

maintainers:
  - Conor Dooley <conor.dooley@microchip.com>

properties:
  compatible:
    const: microchip,polarfire-soc-rng

  syscontroller:
    maxItems: 1
    description: name of the system controller device node

  "#address-cells":
    const: 1

  "#size-cells":
    const: 1

required:
  - compatible
  - "#address-cells"
  - "#size-cells"
  - "syscontroller"

additionalProperties: false

examples:
  - |
    hwrandom: hwrandom {
        compatible = "microchip,polarfire-soc-rng";
        #address-cells = <1>;
        #size-cells = <1>;
        syscontroller = <&syscontroller>;
    };
```

## Documentation/devicetree/bindings/rtc/microchip,mfps-rtc.yaml
```yaml
# SPDX-License-Identifier: (GPL-2.0-only OR BSD-2-Clause)
%YAML 1.2
---
$id: http://devicetree.org/schemas/rtc/microchip,mfps-rtc.yaml#

$schema: http://devicetree.org/meta-schemas/core.yaml#

title: Microchip PolarFire Soc (MPFS) RTC Device Tree Bindings

allOf:
  - $ref: "rtc.yaml#"

maintainers:
  - Daire McNamara <daire.mcnamara@microchip.com>
  - Lewis Hanly <lewis.hanly@microchip.com>

properties:
  compatible:
    enum:
      - microchip,mpfs-rtc

  reg:
    maxItems: 1

  interrupts:
    maxItems: 1

  prescaler:
    maxItems: 1

  clocks:
    maxItems: 1

  clock-names:
    items:
      - const: rtc

required:
  - compatible
  - reg
  - interrupts
  - clocks
  - clock-names

additionalProperties: false

examples:
  - |
    #include <dt-bindings/clock/microchip,mpfs-clock.h>
    soc {
        #address-cells = <2>;
        #size-cells = <2>;
        rtc@20124000 {
            compatible = "microchip,mpfs-rtc";
            reg = <0 0x20124000 0 0x1000>;
            clocks = <&clkcfg CLK_RTC>;
            clock-names = "rtc";
            interrupts = <80>;
        };
    };
...
```

## Documentation/devicetree/bindings/serial/beaglecc1352.yaml
```yaml
# SPDX-License-Identifier: GPL-2.0-only OR BSD-2-Clause
%YAML 1.2
---
$id: http://devicetree.org/schemas/serial/beaglecc1352.yaml#
$schema: http://devicetree.org/meta-schemas/core.yaml#

title: BeaglePlay CC1352 serial UART

maintainers:
  - Ayush Singh <ayushdevel1325@gmail.com>

properties:
  compatible:
    const: beagle,cc1352

required:
  - compatible

additionalProperties: false

examples:
  - |
    beaglecc1352 {
      compatible = "beagle,cc1352";
    };
```

## Documentation/devicetree/bindings/soc/microchip/microchip,mpfs-control-scb.yaml
```yaml
# SPDX-License-Identifier: GPL-2.0-only OR BSD-2-Clause
%YAML 1.2
---
$id: http://devicetree.org/schemas/soc/microchip/microchip,mpfs-control-scb.yaml#
$schema: http://devicetree.org/meta-schemas/core.yaml#

title: Microchip PolarFire SoC System Controller Bus (SCB) Control Register region

maintainers:
  - Conor Dooley <conor.dooley@microchip.com>

description:
  An assortment of system controller related registers, including voltage and
  temperature sensors and the status/control registers for the system
  controller's mailbox.

properties:
  compatible:
    items:
      - const: microchip,mpfs-control-scb
      - const: syscon
      - const: simple-mfd

  reg:
    maxItems: 1

required:
  - compatible
  - reg

additionalProperties: false

examples:
  - |
    soc {
      #address-cells = <1>;
      #size-cells = <1>;

      syscon@37020000 {
        compatible = "microchip,mpfs-control-scb", "syscon", "simple-mfd";
        reg = <0x37020000 0x100>;
      };
    };
```

## Documentation/devicetree/bindings/usb/generic-onboard-device.txt
```
Generic Onboard USB Device

The node should be located at USB host controller's node or
any USB HUB's node.

Required properties:
- compatible: should be "generic-onboard-device"

Optional properties:
- clocks: the input clock for USB device.
- clock-frequency: the frequency for device's clock.
- reset-gpios: Should specify the GPIO for reset.
- reset-duration-us: the duration for assert reset signal, the time unit
  is microsecond.

Example:

&usbh1 {
	vbus-supply = <&reg_usb_h1_vbus>;
        status = "okay";

	#address-cells = <1>;
	#size-cells = <0>;
	hub: usb2415@01 {
	       compatible = "generic-onboard-device";
	       reg = <0x01>;
	       clocks = <&clks IMX6QDL_CLK_CKO>;
	       reset-gpios = <&gpio7 12 GPIO_ACTIVE_LOW>;
	       reset-duration-us = <10>;
	};
};
```
