## Documentation/devicetree/bindings/arm/omap/ext-clocks.txt
```
TI external clock provider properties

External clock provider is used to group SoC external board specific
clock nodes. A separate provider node is required as the TI clock
driver registers clocks hierarchically.

Required properties:
- compatible:		Shall be: "ti,external-clocks"
- clocks:		Contains the external clocks for the board
- clockdomains:		Contains the external clockdomains for the board

Example:

ext_clocks {
	compatible = "ti,external-clocks";

	ext_clocks: clocks {
	};

	ext_clockdomains: clockdomains {
	};
};

...

&ext_clocks {
	gpio_test_clock {
		compatible = "gpio-clock";
		#clock-cells = <0>;
		enable-gpios = <&gpio5 25 GPIO_ACTIVE_HIGH>;
	};
};
```

## Documentation/devicetree/bindings/clock/microchip,mpfs.yaml
```yaml
# SPDX-License-Identifier: (GPL-2.0-only OR BSD-2-Clause)
%YAML 1.2
---
$id: http://devicetree.org/schemas/clock/microchip,mpfs.yaml#
$schema: http://devicetree.org/meta-schemas/core.yaml#

title: Microchip PolarFire Clock Control Module Binding

maintainers:
  - Daire McNamara <daire.mcnamara@microchip.com>

description: |
  Microchip PolarFire clock control (CLKCFG) is an integrated clock controller,
  which gates and enables all peripheral clocks.

  This device tree binding describes 33 gate clocks.  Clocks are referenced by
  user nodes by the CLKCFG node phandle and the clock index in the group, from
  0 to 32.

properties:
  compatible:
    const: microchip,mpfs-clkcfg

  reg:
    maxItems: 1

  clocks:
    maxItems: 1

  '#clock-cells':
    const: 1
    description: |
      The clock consumer should specify the desired clock by having the clock
      ID in its "clocks" phandle cell. See include/dt-bindings/clock/microchip,mpfs-clock.h
      for the full list of PolarFire clock IDs.

  clock-output-names:
    maxItems: 33

required:
  - compatible
  - reg
  - clocks
  - '#clock-cells'
  - clock-output-names

additionalProperties: false

examples:
  # Clock Config node:
  - |
    #include <dt-bindings/clock/microchip,mpfs-clock.h>
    soc {
            #address-cells = <2>;
            #size-cells = <2>;
            clkcfg: clock-controller@20002000 {
                compatible = "microchip,mpfs-clkcfg";
                reg = <0x0 0x20002000 0x0 0x1000>;
                clocks = <&ref>;
                #clock-cells = <1>;
                clock-output-names = "cpu", "axi", "ahb", "envm", "mac0", "mac1", "mmc", "timer",
                                     "mmuart0", "mmuart1", "mmuart2", "mmuart3", "mmuart4",
                                     "spi0", "spi1", "i2c0", "i2c1", "can0", "can1", "usb", "rsvd",
                                     "rtc", "qspi", "gpio0", "gpio1", "gpio2", "ddrc",
                                     "fic0", "fic1", "fic2", "fic3", "athena", "cfm";
        };
    };
```

## Documentation/devicetree/bindings/cpufreq/ti-cpufreq.txt
```
Bindings for TI's CPUFreq driver
================================

The ti-cpufreq driver works with the operating-points-v2 binding described
at [../opp/opp.txt] to make sure the proper OPPs for a platform get enabled
and then creates a "cpufreq-dt" platform device to leverage the cpufreq-dt
driver described in [cpufreq-dt.txt].

Certain TI SoCs, like those in the am335x, am437x, am57xx, and dra7xx
families support different OPPs depending on the silicon variant in use.
The ti-cpufreq driver uses the revision and an efuse value from the SoC to
provide the OPP framework with supported hardware information. This is used
to determine which OPPs from the operating-points-v2 table get enabled. In
order to maintain backwards compatilibity if this information is not present
the "cpufreq-dt" platform device is still created to attempt to find an
operating-points (v1) table, otherwise no OPPs will be available because
safe OPPs cannot be determined.

Required properties:
--------------------
In 'cpus' nodes:
- operating-points-v2: Phandle to the operating-points-v2 table to use
- ti,syscon-efuse: Syscon phandle, offset to efuse register, efuse register
		   mask, and efuse register shift to get the relevant bits
		   that describe OPP availability
- ti,syscon-rev: Syscon and offset used to look up revision value on SoC

In 'operating-points-v2' table:
- opp-supported-hw: Two bitfields indicating:
	1. Which revision of the SoC the OPP is supported by
	2. Which eFuse bits indicate this OPP is available

	A bitwise and is performed against these values and if any bit
	matches, the OPP gets enabled.

NOTE: Without the above, platform-device for "cpufreq-dt" is still created
      but no determination of which OPPs should be available is done, but this
      allows for use of a v1 operating-points table.

Example:
--------

/* From arch/arm/boot/dts/am4372.dtsi */
cpus {
	cpu: cpu@0 {
		...

		operating-points-v2 = <&cpu0_opp_table>;

		ti,syscon-efuse = <&scm_conf 0x610 0x3f 0>;
		ti,syscon-rev = <&scm_conf 0x600>;

		...
	};
};

cpu0_opp_table: opp_table0 {
	compatible = "operating-points-v2";
	opp50@300000000 {
		opp-hz = /bits/ 64 <300000000>;
		opp-microvolt = <950000>;
		opp-supported-hw = <0xFF 0x01>;
		opp-suspend;
	};

	opp100@600000000 {
		opp-hz = /bits/ 64 <600000000>;
		opp-microvolt = <1100000>;
		opp-supported-hw = <0xFF 0x04>;
	};

	opp120@720000000 {
		opp-hz = /bits/ 64 <720000000>;
		opp-microvolt = <1200000>;
		opp-supported-hw = <0xFF 0x08>;
	};

	oppturbo@800000000 {
		opp-hz = /bits/ 64 <800000000>;
		opp-microvolt = <1260000>;
		opp-supported-hw = <0xFF 0x10>;
	};

	oppnitro@1000000000 {
		opp-hz = /bits/ 64 <1000000000>;
		opp-microvolt = <1325000>;
		opp-supported-hw = <0xFF 0x20>;
	};
};
```

## Documentation/devicetree/bindings/display/solomon,ssd16xx.yaml
```yaml
# SPDX-License-Identifier: (GPL-2.0 OR BSD-2-Clause)
%YAML 1.2
---
$id: http://devicetree.org/schemas/display/solomon,ssd16xx.yaml#
$schema: http://devicetree.org/meta-schemas/core.yaml#

title: Solomon Systech SSD16xx e-ink display controller family

maintainers:
  - Devarsh Thakkar <devarsht@ti.com>

description:
  The SSD16xx family includes e-Paper display controllers (SSD1680, SSD1681, SSD1683)
  with integrated gate driver, source driver and timing controller. Different panels
  use these controllers in either monochrome or 3-color configurations. This driver
  uses panel-specific compatibles to distinguish between different display modules
  and their required initialization sequences. The controller uses a 4-wire SPI
  interface and requires GPIO pins for reset, busy status, and data/command control.

allOf:
  - $ref: /schemas/spi/spi-peripheral-props.yaml#

properties:
  compatible:
    enum:
      - gooddisplay,gdey042t81  # 4.2" 400x300 monochrome (SSD1683 controller)

  reg:
    maxItems: 1

  spi-max-frequency:
    maximum: 2000000
    default: 2000000
    description:
      Maximum SPI clock frequency. The SSD16xx family supports up to 2MHz.

  reset-gpios:
    maxItems: 1
    description:
      GPIO connected to the RSTB (reset) pin. Active low.

  busy-gpios:
    maxItems: 1
    description:
      GPIO connected to the BUSY pin. Active high when the controller
      is busy updating the display.

  dc-gpios:
    maxItems: 1
    description:
      GPIO connected to the D/C (Data/Command) pin. Low for command,
      high for data.

required:
  - compatible
  - reg
  - reset-gpios
  - busy-gpios
  - dc-gpios

unevaluatedProperties: false

examples:
  - |
    #include <dt-bindings/gpio/gpio.h>

    spi {
        #address-cells = <1>;
        #size-cells = <0>;

        display@0 {
            compatible = "gooddisplay,gdey042t81";
            reg = <0>;
            spi-max-frequency = <2000000>;
            reset-gpios = <&gpio1 17 GPIO_ACTIVE_LOW>;
            busy-gpios = <&gpio1 18 GPIO_ACTIVE_HIGH>;
            dc-gpios = <&gpio1 19 GPIO_ACTIVE_HIGH>;
        };
    };
```

## Documentation/devicetree/bindings/dma/microchip,mpfs-pdma-uio.yaml
```yaml
# SPDX-License-Identifier: GPL-2.0
%YAML 1.2
---
$id: http://devicetree.org/schemas/dma/microchip,mpfs-pdma-uio.yaml#
$schema: http://devicetree.org/meta-schemas/core.yaml#

title: Microchip PolarFire SoC UIO Platform DMA

maintainers:
  - Daire McNamara <daire.mcnamara@microchip.com>

description: |
  Platform DMA is a DMA engine of SiFive Unleashed. It supports 4
  channels. Each channel has 2 interrupts. One is for DMA done and
  the other is for DME error.

  For designs using FPGA fabric PDMA is used to shuttle buffers
  between user-space and FPGA fabric.

  https://static.dev.sifive.com/FU540-C000-v1.0.pdf

properties:
  compatible:
    items:
      - const: microchip,mpfs-pdma-uio

  reg:
    maxItems: 1

  interrupts:
    minItems: 1
    maxItems: 8

  '#dma-cells':
    const: 1

required:
  - compatible
  - reg
  - interrupts
  - '#dma-cells'

examples:
  - |
    dma@3000000 {
      compatible = "microchip,mpfs-pdma-uio";
      reg = <0x0 0x3000000 0x0 0x8000>;
      interrupts = <23 24 25 26 27 28 29 30>;
      #dma-cells = <1>;
    };

...
```

## Documentation/devicetree/bindings/gpio/microchip,mpfs-gpio.yaml
```yaml
# SPDX-License-Identifier: (GPL-2.0 OR BSD-2-Clause)
%YAML 1.2
---
$id: http://devicetree.org/schemas/gpio/microchip,mpfs-gpio.yaml#
$schema: http://devicetree.org/meta-schemas/core.yaml#

title: Microchip MPFS GPIO Controller

maintainers:
  - Conor Dooley <conor.dooley@microchip.com>

properties:
  compatible:
    items:
      - enum:
          - microchip,mpfs-gpio
          - microchip,coregpio-rtl-v3

  reg:
    maxItems: 1

  interrupts:
    description:
      Interrupt mapping, one per GPIO. Maximum 32 GPIOs.
    minItems: 14
    maxItems: 32

  interrupt-controller: true

  clocks:
    maxItems: 1

  "#gpio-cells":
    const: 2

  "#interrupt-cells":
    const: 2

  ngpios:
    description:
      The number of GPIOs available.
    enum: [14, 16, 20, 24, 32]

  gpio-controller: true
  gpio-line-names: true

patternProperties:
  "^.+-hog(-[0-9]+)?$":
    type: object

    additionalProperties: false

    properties:
      gpio-hog: true
      gpios: true
      input: true
      output-high: true
      output-low: true
      line-name: true

    required:
      - gpio-hog
      - gpios

allOf:
  - if:
      properties:
        compatible:
          contains:
            const: microchip,mpfs-gpio
    then:
      required:
        - interrupts
        - "#interrupt-cells"
        - interrupt-controller

required:
  - compatible
  - reg
  - "#gpio-cells"
  - gpio-controller
  - ngpios
  - clocks

additionalProperties: false

examples:
  - |
    gpio@20122000 {
        compatible = "microchip,mpfs-gpio";
        reg = <0x20122000 0x1000>;
        clocks = <&clkcfg 25>;
        interrupt-parent = <&irqmux>;
        gpio-controller;
        #gpio-cells = <2>;
        ngpios = <32>;
        interrupt-controller;
        #interrupt-cells = <2>;
        interrupts = <64>, <65>, <66>, <67>,
                     <68>, <69>, <70>, <71>,
                     <72>, <73>, <74>, <75>,
                     <76>, <77>, <78>, <79>,
                     <80>, <81>, <82>, <83>,
                     <84>, <85>, <86>, <87>,
                     <88>, <89>, <90>, <91>,
                     <92>, <93>, <94>, <95>;
    };
...
```

## Documentation/devicetree/bindings/gpu/img,powervr.yaml
```yaml
# SPDX-License-Identifier: (GPL-2.0-only OR MIT)
# Copyright (c) 2022 Imagination Technologies Ltd.
%YAML 1.2
---
$id: http://devicetree.org/schemas/gpu/img,powervr.yaml#
$schema: http://devicetree.org/meta-schemas/core.yaml#

title: Imagination Technologies PowerVR GPU

maintainers:
  - Sarah Walker <sarah.walker@imgtec.com>

properties:
  compatible:
    oneOf:
      - items:
          - enum:
              - mediatek,mt8173-gpu
          - const: img,powervr-series6xt
      - items:
          - enum:
              - ti,am62-gpu
          - const: img,powervr-seriesaxe

  reg:
    maxItems: 1

  clocks:
    minItems: 1
    maxItems: 3

  clock-names:
    items:
      - const: core
      - const: mem
      - const: sys

  interrupts:
    items:
      - description: GPU interrupt

  interrupt-names:
    items:
      - const: gpu

  power-domains:
    maxItems: 1

  operating-points-v2: true
  opp-table: true
  power-supply: true

  "#cooling-cells":
    const: 2

required:
  - compatible
  - reg
  - clocks
  - clock-names
  - interrupts
  - interrupt-names

additionalProperties: false

allOf:
  - if:
      properties:
        compatible:
          contains:
            const: mediatek,mt8173-gpu
    then:
      properties:
        reg:
          minItems: 2
          maxItems: 2
  - if:
      properties:
        compatible:
          contains:
            const: img,powervr-series6xt
    then:
      properties:
        clocks:
          minItems: 3

examples:
  - |
    #include <dt-bindings/interrupt-controller/irq.h>
    #include <dt-bindings/interrupt-controller/arm-gic.h>

    gpu@13000000 {
        compatible = "mediatek,mt8173-gpu", "img,powervr-series6xt";
        reg = <0 0x13000000 0 0xffff>, <0 0x13fff000 0 0x1000>;
        power-domains = <&scpsys MT8173_POWER_DOMAIN_MFG>;
        power-supply = <&da9211_vgpu_reg>;
        operating-points-v2 = <&gpu_opp_table>;
        clocks = <&gpu_ckgen 0>,
                 <&gpu_ckgen 1>,
                 <&gpu_ckgen 2>;
        clock-names = "core",
                      "mem",
                      "sys";
        interrupts = <GIC_SPI 217 IRQ_TYPE_LEVEL_LOW>;
        interrupt-names = "gpu";
    };

    gpu_opp_table: opp-table {
      compatible = "operating-points-v2";

      opp-598000000 {
        opp-hz = /bits/ 64 <598000000>;
        opp-microvolt = <1130000>;
      };
      opp-494000000 {
        opp-hz = /bits/ 64 <494000000>;
        opp-microvolt = <1130000>;
      };
      opp-455000000 {
        opp-hz = /bits/ 64 <455000000>;
        opp-microvolt = <1000000>;
      };
      opp-396500000 {
        opp-hz = /bits/ 64 <396500000>;
        opp-microvolt = <1000000>;
      };
      opp-299000000 {
        opp-hz = /bits/ 64 <299000000>;
        opp-microvolt = <1000000>;
      };
      opp-253500000 {
        opp-hz = /bits/ 64 <253500000>;
        opp-microvolt = <1000000>;
      };
    };
```
