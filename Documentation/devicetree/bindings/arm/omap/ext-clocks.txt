## Documentation/devicetree/bindings/memory-controllers/ti/cdns,j7-ddr.yaml
```yaml
# SPDX-License-Identifier: GPL-2.0-only OR BSD-2-Clause
%YAML 1.2
---
$id: http://devicetree.org/schemas/memory-controllers/ti/cdns,j7-ddr.yaml#
$schema: http://devicetree.org/meta-schemas/core.yaml#

title: Cadence DDR controller for K3 devices

maintainers:
  - Gandhar Deshpande <g-deshpande@ti.com>
  - Santhosh Kumar K <s-k6@ti.com>
  - Neha Malcom Francis <n-francis@ti.com>

properties:
  compatible:
    const: cdns,j7-ddr

  reg:
    minItems: 3
    maxItems: 3
    description: |
      Address ranges for the different register regions of the DDRSS controller.
      - ctl_cfg: Controller configuration registers
      - ctl_cfg_pi: PHY Interface configuration registers
      - ctl_cfg_phy: PHY configuration registers

  reg-names:
    items:
      - const: ctl_cfg
      - const: ctl_cfg_pi
      - const: ctl_cfg_phy

  ti,ctl-data:
    $ref: /schemas/types.yaml#/definitions/uint32-array
    description: |
      Array of controller register values for DDR initialization.
      These values configure the DDR controller parameters.

  ti,pi-data:
    $ref: /schemas/types.yaml#/definitions/uint32-array
    description: |
      Array of PHY Interface register values for DDR initialization.
      These values configure the interface between controller and PHY.

  ti,phy-data:
    $ref: /schemas/types.yaml#/definitions/uint32-array
    description: |
      Array of PHY register values for DDR initialization.
      These values configure the DDR PHY parameters.

required:
  - compatible
  - reg
  - reg-names

unevaluatedProperties: false

examples:
  - |
    #include <dt-bindings/interrupt-controller/arm-gic.h>
    #include <dt-bindings/soc/ti,sci_pm_domain.h>

    cbass_main {
      #address-cells = <2>;
      #size-cells = <2>;

      memorycontroller: memory-controller@298e000 {
        compatible = "ti,j7-ddrss";
        reg = <0x00 0x02980000 0x00 0x184>;
        reg-names = "ss_cfg";
        ranges = <0x00 0x00 0x00 0x02990000 0x00 0x00004000>;
        interrupts = <GIC_SPI 216 IRQ_TYPE_LEVEL_HIGH>;
        power-domains = <&k3_pds 8 TI_SCI_PD_EXCLUSIVE>,
                      <&k3_pds 90 TI_SCI_PD_SHARED>;
        clocks = <&k3_clks 8 0>, <&k3_clks 30 9>;
        bootph-pre-ram;
        ti,ddr-freq1 = <0x27b9fba0>;
        ti,ddr-freq2 = <0x27b9fba0>;
        ti,ddr-fhs-cnt = <0xa>;
        #address-cells = <2>;
        #size-cells = <2>;

        ddr@0 {
          compatible = "cdns,j7-ddr";
          reg = <0x00 0x0000 0x00 0x72c>,
                <0x00 0x2000 0x00 0x4b0>,
                <0x00 0x4000 0x00 0x163c>;
          reg-names = "ctl_cfg", "ctl_cfg_pi", "ctl_cfg_phy";
          bootph-pre-ram;

          ti,ctl-data = <
            0xb00
            0x0
            0x0
          >;

          ti,pi-data = <
            0xb00
            0x0
            0x0
          >;

          ti,phy-data = <
            0x4f0
            0x0
            0x30200
          >;
        };
      };
    };
```

## Documentation/devicetree/bindings/memory-controllers/ti/ti,j7-ddrss.yaml
```yaml
# SPDX-License-Identifier: (GPL-2.0-only OR BSD-2-Clause)
%YAML 1.2
---
$id: http://devicetree.org/schemas/memory-controllers/ti/ti,j7-ddrss.yaml#
$schema: http://devicetree.org/meta-schemas/core.yaml#

title: TI wrapper module for the Cadence DDRSS controller

maintainers:
  - Gandhar Deshpande <g-deshpande@ti.com>
  - Santhosh Kumar K <s-k6@ti.com>
  - Neha Malcom Francis <n-francis@ti.com>

description: |
  The J721E DDR subsystem comprises DDR controller, DDR PHY and wrapper
  logic to integrate these blocks in the device. The DDR subsystem is
  used to provide an interface to external SDRAM devices which can be
  utilized for storing program or data.

properties:
  compatible:
    enum:
      - ti,j7-ddrss
      - ti,am62-ddrss
      - ti,am62a-ddrss

  reg:
    minItems: 1
    maxItems: 2
    description: |
      Address ranges for the different register regions of the DDRSS controller.
      - ss_cfg: Subsystem configuration registers

  reg-names:
    items:
      - const: ss_cfg

  ranges:
    minItems: 1

  interrupts:
    maxItems: 1
    description: |
      Interrupt line for the DDR subsystem controller. This interrupt is
      typically used for temperature monitoring and error reporting.

  power-domains:
    minItems: 1
    maxItems: 2
    description: |
      Power domains required by the DDR subsystem:
      - an entry to TISCI DDR CFG device
      - an entry to TISCI DDR DATA.

  clocks:
    minItems: 1
    maxItems: 2
    description: |
      - An entry to DDRSS clock
      - An entry to SoC bypass clock

  ti,ddr-freq1:
    $ref: /schemas/types.yaml#/definitions/uint32
    description: |
      Primary DDR frequency setting in Hz. This value is used for
      normal operation of the DDR subsystem.

  ti,ddr-freq2:
    $ref: /schemas/types.yaml#/definitions/uint32
    description: |
      Secondary DDR frequency setting in Hz. This value can be used
      for power saving or performance modes.

  ti,ddr-fhs-cnt:
    $ref: /schemas/types.yaml#/definitions/uint32
    description: |
      Frequency handover sequence count. This value defines how many
      steps to use when switching between frequency settings.

  '#address-cells':
    const: 2

  '#size-cells':
    const: 2

patternProperties:
  "^ddr@":
    type: object

required:
  - compatible
  - reg
  - reg-names
  - ranges
  - interrupts
  - power-domains
  - clocks

additionalProperties: false

examples:
  - |
    #include <dt-bindings/interrupt-controller/arm-gic.h>
    #include <dt-bindings/soc/ti,sci_pm_domain.h>

    cbass_main {
      #address-cells = <2>;
      #size-cells = <2>;

      memorycontroller: memory-controller@298e000 {
        compatible = "ti,j7-ddrss";
        reg = <0x00 0x02980000 0x00 0x184>;
        reg-names = "ss_cfg";
        ranges = <0x00 0x00 0x00 0x02990000 0x00 0x00004000>;
        interrupts = <GIC_SPI 216 IRQ_TYPE_LEVEL_HIGH>;
        power-domains = <&k3_pds 8 TI_SCI_PD_EXCLUSIVE>,
                      <&k3_pds 90 TI_SCI_PD_SHARED>;
        clocks = <&k3_clks 8 0>, <&k3_clks 30 9>;
        bootph-pre-ram;
        ti,ddr-freq1 = <0x27b9fba0>;
        ti,ddr-freq2 = <0x27b9fba0>;
        ti,ddr-fhs-cnt = <0xa>;
        #address-cells = <2>;
        #size-cells = <2>;

        ddr@0 {
          compatible = "cdns,j7-ddr";
          reg = <0x00 0x0000 0x00 0x72c>,
                <0x00 0x2000 0x00 0x4b0>,
                <0x00 0x4000 0x00 0x163c>;
          reg-names = "ctl_cfg", "ctl_cfg_pi", "ctl_cfg_phy";
          bootph-pre-ram;

          ti,ctl-data = <
            0xb00
            0x0
            0x0
          >;

          ti,pi-data = <
            0xb00
            0x0
            0x0
          >;

          ti,phy-data = <
            0x4f0
            0x0
            0x30200
          >;
        };
      };
    };
```

## Documentation/devicetree/bindings/net/allwinner,sun8i-emac.txt
```
* Allwinner sun8i EMAC ethernet controller

Required properties:
- compatible: "allwinner,sun8i-a83t-emac", "allwinner,sun8i-h3-emac",
		or "allwinner,sun50i-a64-emac"
- reg: address and length of the register sets for the device.
- reg-names: should be "emac" and "syscon", matching the register sets
- interrupts: interrupt for the device
- clocks: A phandle to the reference clock for this device
- clock-names: should be "ahb"
- resets: A phandle to the reset control for this device
- reset-names: should be "ahb"
- phy-mode: See ethernet.txt
- phy or phy-handle: See ethernet.txt
- #address-cells: shall be 1
- #size-cells: shall be 0

"allwinner,sun8i-h3-emac" also requires:
- clocks: an extra phandle to the reference clock for the EPHY
- clock-names: an extra "ephy" entry matching the clocks property
- resets: an extra phandle to the reset control for the EPHY
- resets-names: an extra "ephy" entry matching the resets property

See ethernet.txt in the same directory for generic bindings for ethernet
controllers.

The device node referenced by "phy" or "phy-handle" should be a child node
of this node. See phy.txt for the generic PHY bindings.

Optional properties:
- phy-supply: phandle to a regulator if the PHY needs one
- phy-io-supply: phandle to a regulator if the PHY needs a another one for I/O.
		 This is sometimes found with RGMII PHYs, which use a second
		 regulator for the lower I/O voltage.
- allwinner,tx-delay: The setting of the TX clock delay chain
- allwinner,rx-delay: The setting of the RX clock delay chain

The TX/RX clock delay chain settings are board specific.

Optional properties for "allwinner,sun8i-h3-emac":
- allwinner,use-internal-phy: Use the H3 SoC's internal E(thernet) PHY
- allwinner,leds-active-low: EPHY LEDs are active low

When the internal PHY is requested, the implementation shall configure the
internal PHY to use the address specified in the child PHY node.

Example:

emac: ethernet@01c0b000 {
	compatible = "allwinner,sun8i-h3-emac";
	reg = <0x01c0b000 0x104>, <0x01c00030 0x4>;
	reg-names = "emac", "syscon";
	interrupts = <GIC_SPI 82 IRQ_TYPE_LEVEL_HIGH>;
	clocks = <&bus_gates 17>, <&bus_gates 128>;
	clock-names = "ahb", "ephy";
	resets = <&ahb_rst 17>, <&ahb_rst 66>;
	reset-names = "ahb", "ephy";
	phy = <&phy1>;
	allwinner,use-internal-phy;
	allwinner,leds-active-low;

	phy1: ethernet-phy@1 {
		reg = <1>;
	};
};
```

## Documentation/devicetree/bindings/net/wireless/ti,cc33xx.yaml
```yaml
# SPDX-License-Identifier: (GPL-2.0-only OR BSD-2-Clause)
%YAML 1.2
---
$id: http://devicetree.org/schemas/net/wireless/ti,cc33xx.yaml#
$schema: http://devicetree.org/meta-schemas/core.yaml#

title: Texas Instruments CC33xx Wireless LAN Controller

maintainers:
  - Michael Nemanov <michael.nemanov@ti.com>

description:
  The CC33xx is a family of IEEE 802.11ax chips from Texas Instruments.
  These chips must be connected via SDIO and support in-band / out-of-band IRQ.

properties:
  $nodename:
    pattern: "^wifi@2"

  compatible:
    oneOf:
      - const: ti,cc3300
      - items:
          - enum:
              - ti,cc3301
              - ti,cc3350
              - ti,cc3351
          - const: ti,cc3300

  reg:
    const: 2

  interrupts:
    description:
      The out-of-band interrupt line.
      Can be IRQ_TYPE_EDGE_RISING or IRQ_TYPE_LEVEL_HIGH.
      If property is omitted, SDIO in-band IRQ will be used.
    maxItems: 1

required:
  - compatible
  - reg

additionalProperties: false

examples:
  - |
    #include <dt-bindings/interrupt-controller/irq.h>

    mmc {
        #address-cells = <1>;
        #size-cells = <0>;

        wifi@2 {
            compatible = "ti,cc3300";
            reg = <2>;
            interrupts = <19 IRQ_TYPE_EDGE_RISING>;
        };
    };
```

## Documentation/devicetree/bindings/remoteproc/microchip,ipc-remoteproc.yaml
```yaml
# SPDX-License-Identifier: (GPL-2.0-only OR BSD-2-Clause)
%YAML 1.2
---
$id: "http://devicetree.org/schemas/remoteproc/microchip,ipc-remoteproc.yaml#"
$schema: "http://devicetree.org/meta-schemas/core.yaml#"

title: Microchip IPC Remote Processor

description:
  Microchip family of RISC-V SoCs typically have one or more
  clusters. These clusters can be configured to run in an Asymmetric
  Multi Processing (AMP) mode where clusters are split in independent
  software contexts.

  This document defines the binding for the remoteproc component that
  loads and boots firmwares on remote clusters.

  This SBI interface is compatible with the Mi-V Inter-hart
  Communication (IHC) IP.

maintainers:
  - Valentina Fernandez <valentina.fernandezalanis@microchip.com>

properties:
  compatible:
    const: microchip,ipc-remoteproc

  mboxes:
    description:
      This property is required only if the rpmsg/virtio functionality is used.
      Microchip IPC mailbox specifier. To be used for communication with a
      remote cluster. The specifier format is as per the bindings,
      Documentation/devicetree/bindings/mailbox/microchip,sbi-ipc.yaml
    maxItems: 1

  microchip,auto-boot:
    $ref: /schemas/types.yaml#/definitions/flag
    description:
      If defined, when remoteproc is probed, it loads the default firmware and
      starts the remote processor.

  memory-region:
    description:
      If present, a phandle for a reserved memory area that used for vdev buffer,
      resource table, vring region and others used by remote cluster.

required:
  - compatible

additionalProperties: false

examples:
  - |

    reserved-memory {
        #address-cells = <1>;
        #size-cells = <1>;

        contextb: contextb_reserved@81000000 {
          reg = <0x81000000 0x400000>;
          no-map;
        };
    };

    soc {
      #address-cells = <2>;
      #size-cells = <2>;

      rproc-contextb {
          compatible = "microchip,ipc-remoteproc";
          memory-region = <&contextb>;
          mboxes= <&ihc 8>;
      };
    };

...
```

## Documentation/devicetree/bindings/remoteproc/ti,pru-rproc.txt
```
PRU Core on TI SoCs
===================

Each PRUSS has dual PRU cores, each represented by a PRU child node. Each node
can optionally be rendered inactive by using the standard DT string property,
"status".

Required Properties:
--------------------
- compatible     : should be
                       "ti,am3356-pru" for AM335x family of SoCs
                       "ti,am4376-pru" for AM437x family of SoCs
                       "ti,am5728-pru" for AM57xx family of SoCs
                       "ti,k2g-pru" for 66AK2G family of SoCs
- reg            : base address and size for each of the 3 sub-module address
                   spaces as mentioned in reg-names, and in the same order as
                   the reg-names
- reg-names      : should contain each of the following 3 names, the binding is
                   agnostic of the order of these reg-names
                       "iram" for Instruction RAM,
                       "control" for the CTRL sub-module registers,
                       "debug" for the Debug sub-module registers,

- firmware-name  : should contain the name of the firmware image file
		   located on the firmware search path. This firmware will be
		   used as default if the Application node or User (via sysfs)
		   doesn't provide a firmware-name.

- gpcfg		 : pHandle to CFG module's syscon regmap and offset to PRU's
		   GPCFG register.

Optional Properties:
--------------------
The virtio based communication between the MPU and a PRU core _requires_
either the 'mboxes' property, or the set of 'interrupt-parent', 'interrupts'
and 'interrupt-names' properties to be defined. The latter option is the
preferred choice. The 'mboxes' property is not applicable for 66AK2G and
DA850/OMAP-L138 SoCs.

- mboxes           : OMAP Mailbox specifier denoting the sub-mailbox, if using
                     a mailbox for IPC signalling between host and a PRU core.
                     The specifier format is as per the bindings,
                         Documentation/devicetree/bindings/mailbox/omap-mailbox.txt
                     This property should match with the sub-mailbox node used
                     in the corresponding firmware image.
- interrupt-parent : phandle to the PRUSS INTC node. Should be defined if
                     interrupts property is to be used.
- interrupts       : array of interrupt specifiers if using PRU system events
                     for IPC signalling between host and a PRU core. This
                     property should match with the PRU system event used in
                     the corresponding firmware image.
- interrupt-names  : should use one of the following names for each interrupt,
                     the name should match the corresponding PRU system event
                     number,
                         "vring" - for PRU to HOST virtqueue signalling
                         "kick"  - for HOST to PRU virtqueue signalling
```
