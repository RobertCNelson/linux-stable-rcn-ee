## Documentation/devicetree/bindings/i2c/microchip,mpfs-i2c.yaml
```yaml
# SPDX-License-Identifier: (GPL-2.0-only OR BSD-2-Clause)
%YAML 1.2
---
$id: http://devicetree.org/schemas/i2c/microchip,mpfs-i2c.yaml#
$schema: http://devicetree.org/meta-schemas/core.yaml#

title: Microchip MPFS I2C Controller Device Tree Bindings

maintainers:
  - Daire McNamara <daire.mcnamara@microchip.com>

description: |
  This I2C controller is found on the Microchip PolarFire SoC.

allOf:
  - $ref: /schemas/i2c/i2c-controller.yaml#

properties:
  compatible:
    enum:
      - microchip,mpfs-i2c # Microchip PolarFire SoC compatible SoCs
      - microchip,core-i2c # Microchip Fabric based i2c IP core

  reg:
    maxItems: 1

  interrupts:
    maxItems: 1

  clocks:
    description: Phandle of the clock feeding the I2C controller.
    minItems: 1

  clock-frequency:
    description: |
      Desired I2C bus clock frequency in Hz. As only Standard and Fast
      modes are supported, possible values are 100000 and 400000.
    enum: [100000, 400000]

required:
  - compatible
  - reg
  - interrupts
  - clocks

unevaluatedProperties: false

examples:
  - |
    #include <dt-bindings/clock/microchip,mpfs-clock.h>
    soc {
        #address-cells = <2>;
        #size-cells = <2>;
        i2c@2010a000 {
            compatible = "microchip,mpfs-i2c";
            reg = <0 0x2010a000 0 0x1000>;
            interrupts = <58>;
            clock-frequency = <100000>;
            clocks = <&clkcfg CLK_I2C0>;
        };
    };
  - |
    #include <dt-bindings/clock/microchip,mpfs-clock.h>
    soc {
        #address-cells = <2>;
        #size-cells = <2>;
        i2c@2010b000 {
            compatible = "microchip,mpfs-i2c";
            reg = <0 0x2010b000 0 0x1000>;
            interrupts = <61>;
            clock-frequency = <100000>;
            clocks = <&clkcfg CLK_I2C1>;
        };
    };
...
```

## Documentation/devicetree/bindings/iio/adc/microchip,pac1934.yaml
```yaml
# SPDX-License-Identifier: (GPL-2.0 OR BSD-2-Clause)
%YAML 1.2
---
$id: http://devicetree.org/schemas/iio/adc/microchip,pac1934.yaml#
$schema: http://devicetree.org/meta-schemas/core.yaml#

title: Microchip PAC1934 Power Monitors with Accumulator

maintainers:
  - Marius Cristea <marius.cristea@microchip.com>

properties:
  compatible:
    enum:
      - microchip,pac1931
      - microchip,pac1932
      - microchip,pac1933
      - microchip,pac1934

  reg:
    maxItems: 1

  "#address-cells":
    const: 1

  "#size-cells":
    const: 0

required:
  - compatible
  - reg
  - "#address-cells"
  - "#size-cells"

patternProperties:
  "^channel@[1-4]+$":
    $ref: "adc.yaml"
    type: object
    description: Represents the external channels which are connected to the ADC.

    properties:
      reg:
        description: The channel number.
          It can have up to 4 channels, numbered from 1 to 4.
        items:
          - minimum: 1
            maximum: 4

      shunt-resistor-micro-ohms:
        description: |
          Value in micro Ohms of the shunt resistor connected between
          the SENSE+ and SENSE- inputs, across which the current is measured. Value
          is needed to compute the scaling of the measured current.

      label:
        description: Name of the monitored power rail.

      bipolar:
        description: Whether the channel is bi-directional.
        type: boolean

    required:
      - reg
      - shunt-resistor-micro-ohms
      - label

    additionalProperties: false

additionalProperties: false

examples:
  - |
    i2c {
        #address-cells = <1>;
        #size-cells = <0>;

        pac193x: pac193x@10 {
            compatible = "microchip,pac1934";
            reg = <0x10>;

            #address-cells = <1>;
            #size-cells = <0>;

            channel@1 {
                reg = <0x1>;
                shunt-resistor-micro-ohms = <24900000>;
                label = "CPU";
            };

            channel@2 {
                reg = <0x2>;
                shunt-resistor-micro-ohms = <49900000>;
                label = "GPU";
            };

            channel@3 {
                reg = <0x3>;
                shunt-resistor-micro-ohms = <75000000>;
                label = "MEM";
                bipolar;
            };

            channel@4 {
                reg = <0x4>;
                shunt-resistor-micro-ohms = <100000000>;
                label = "NET";
                bipolar;
            };
        };
    };

...
```

## Documentation/devicetree/bindings/iio/adc/microchip,pac193x.yaml
```yaml
# SPDX-License-Identifier: (GPL-2.0 OR BSD-2-Clause)
%YAML 1.2
---
$id: http://devicetree.org/schemas/iio/adc/microchip,pac193x.yaml#
$schema: http://devicetree.org/meta-schemas/core.yaml#

title: Microchip pac193x family of power monitors

maintainers:
  - Conor Dooley <conor.dooley@microchip.com>

description: |
   The PAC193{1,2,4} are [one,two,four] channel power/energy monitors with current sensor
   amplifier and bus voltage monitors that feed high resolution ADCs. Digital circuitry
   performs power calculations and energy accumulation. The sampling rate and energy
   integration period can be controlled over I2C. Active channel selection, one-shot
   measurements and other controls are also configurable by I2C

properties:
  compatible:
    enum:
      - microchip,pac1931
      - microchip,pac1932
      - microchip,pac1934
  reg:
    maxItems: 1

  microchip,samp-rate:
    description:
      User programmable sampling rate of the accumulator
    $ref: /schemas/types.yaml#/definitions/uint32
    enum: [8, 64, 256, 1024]
    default: 64

  "#address-cells":
    const: 1

  "#size-cells":
    const: 0

patternProperties:
  "^channel[0-3]$":
    type: object
    description:
      Configuration details for the individual channels on the device
    properties:
      microchip,channel-enabled:
        description: |
          Flag that determines whether a given channel is enabled.
        $ref: "/schemas/types.yaml#/definitions/flag"

      microchip,bi-directional:
        description: |
          Flag that determines whether a given channel is in
          bi-directional mode.
        $ref: "/schemas/types.yaml#/definitions/flag"

      microchip,uohms-shunt-res:
        maxItems: 1
        description: |
          The size of a channels sense resistor, used to perform
          current & power measurements in micro-ohms
        $ref: /schemas/types.yaml#/definitions/uint32

    required:
      - microchip,uohms-shunt-res

required:
  - reg
  - microchip,samp-rate


additionalProperties: false

examples:
  - |
    i2c {
      adc@10 {
        compatible = "microchip,pac1934";
        reg = <0x10>;
        microchip,samp-rate = <64>;
        status = "okay";
        ch0: channel0 {
          microchip,uohms-shunt-res = <10000>;
          microchip,channel-enabled;
        };
        ch1: channel1 {
          microchip,uohms-shunt-res = <10000>;
          microchip,channel-enabled;
        };
        ch2: channel2 {
          microchip,uohms-shunt-res = <10000>;
          microchip,channel-enabled;
        };
        ch3: channel3 {
          microchip,uohms-shunt-res = <10000>;
          microchip,channel-enabled;
        };
      };
    };
...
```

## Documentation/devicetree/bindings/interrupt-controller/ti,pruss-intc-irq.txt
```
PRU ICSS INTC on TI SoCs
========================

Each PRUSS has a single interrupt controller instance that is common to both
the PRU cores. Each interrupt controller can detect 64 input events which are
then mapped to 10 possible output interrupts through two levels of mapping. The
input events can be triggered by either the PRUs and/or various other PRUSS
internal and external peripherals. The first 2 output interrupts are fed
exclusively to the internal PRU cores, with the remaining 8 connected to
external interrupt controllers including the MPU.

Required Properties:
--------------------
- compatible           : should be one of,
                             "ti,am3356-pruss-intc" for AM335x family of SoCs
                             "ti,am4376-pruss-intc" for AM437x family of SoCs
                             "ti,am5728-pruss-intc" for AM57xx family of SoCs
                             "ti,k2g-pruss-intc" for 66AK2G family of SoCs
- reg                  : base address and size for the PRUSS INTC sub-module
- reg-names            : should contain the string "intc"
- interrupts     : all the interrupts generated towards the main host
                   processor in the SoC. The format depends on the
                   interrupt specifier for the particular SoC's MPU
                   parent interrupt controller
- interrupt-names: should use one of the following names for each interrupt,
                   the name should match the corresponding host interrupt
                   number,
                       "host2", "host3", "host4", "host5", "host6",
                       "host7", "host8" or "host9"
                   NOTE: AM437x and 66AK2G SoCs do not have "host7" interrupt
                         connected to MPU
- interrupt-controller : mark this node as an interrupt controller
- #interrupt-cells     : should be 1. Client users shall use the PRU System
                         event number (the interrupt source that the client
                         is interested in) as the value of the interrupts
                         property in their node

Example:
--------
		pruss_intc: intc@20000 {
			compatible = "ti,am3356-pruss-intc";
			reg = <0x20000 0x2000>;
			reg-names = "intc";
			interrupt-controller;
			#interrupt-cells = <1>;
			interrupts = <20 21 22 23 24 25 26 27>;
			interrupt-names = "host2", "host3", "host4",
					  "host5", "host6", "host7",
					  "host8", "host9";
		};
```

## Documentation/devicetree/bindings/mailbox/microchip,miv-ihc.yaml
```yaml
# SPDX-License-Identifier: (GPL-2.0-only OR BSD-2-Clause)
%YAML 1.2
---
$id: "http://devicetree.org/schemas/mailbox/microchip,miv-ihc.yaml#"
$schema: "http://devicetree.org/meta-schemas/core.yaml#"

title: Microchip PolarFire Mi-V Inter-hart communication (IHC) driver

maintainers:
  - Valentina Fernandez <valentina.fernandezalanis@microchip.com>
  - Conor Dooley <Conor Dooley <conor.dooley@microchip.com>>

description: |
  The Mi-V Inter-hart Communication (IHC) subsystem is used to exchage
  data between harts in PolarFire SoC. It provides the ability to
  send messages (ie. data, status and control) and coordinate between
  harts through a non-blocking interrupt signaling mechanism.

properties:
  compatible:
    const: microchip,miv-ihc

  interrupts:
    description: Should contain the IHC interrupt associated with the lowest
    hart ID in the local software context.
    maxItems: 1

  miv-ihc,remote-context-id:
    $ref: /schemas/types.yaml#/definitions/uint32
    enum: [5, 6]
    description: |
      ID of the software context where data should be sent to.
      Should be either a value of 5 (Context A) or 6 (Context B).
      A default value of 6 should be used to match default IHC configuration 
      (Linux on context A and RTOS/BM on context B).

  "#mbox-cells":
    const: 1

required:
  - compatible
  - interrupts
  - "#mbox-cells"
  - miv-ihc,remote-context-id

additionalProperties: false

examples:
  - |
    soc {
      #address-cells = <2>;
      #size-cells = <2>;
      ihc: ihc {
        compatible = "microchip,miv-ihc";
        interrupt-parent = <&plic>;
        interrupts = <IHC_HART1_INT>;
        miv-ihc,remote-context-id = <IHC_CONTEXT_B>;
        #mbox-cells = <1>;
      };
    };
```

## Documentation/devicetree/bindings/mailbox/microchip,sbi-ipc.yaml
```yaml
# SPDX-License-Identifier: (GPL-2.0-only OR BSD-2-Clause)
%YAML 1.2
---
$id: http://devicetree.org/schemas/mailbox/microchip,sbi-ipc.yaml#
$schema: http://devicetree.org/meta-schemas/core.yaml#

title: Microchip Inter-processor communication (IPC) mailbox controller

maintainers:
  - Valentina Fernandez <valentina.fernandezalanis@microchip.com>

description:
  The Microchip Inter-processor Communication (IPC) is used to exchange
  data between processors. It provides the ability to send and receive
  messages through a non-blocking interrupt signaling mechanism.
  This SBI interface is compatible with the Mi-V Inter-hart
  Communication (IHC) IP.
  The microchip,sbi-ipc compatible string is inteded for use by software
  running in s-mode. The SoC-specific compatibles are inteded for use
  by the SBI implementation (m-mode).

properties:
  compatible:
    enum:
      - microchip,sbi-ipc
      - microchip,miv-ihc-rtl-v2

  reg:
    maxItems: 1

  interrupts:
    minItems: 1
    maxItems: 5

  interrupt-names:
    minItems: 1
    maxItems: 5

  "#mbox-cells":
    description:
      For the SBI "device", the cell represents the global "logical" channel IDs.
      The meaning of channel IDs are platform firmware dependent. The
      SoC-specific compatibles are intended for use by the SBI implementation,
      rather than s-mode software. There the cell would represent the physical
      channel and do not vary depending on platform firmware.
    const: 1

required:
  - compatible
  - interrupts
  - interrupt-names
  - "#mbox-cells"

additionalProperties: false

allOf:
  - if:
      properties:
        compatible:
          contains:
            const: microchip,sbi-ipc
    then:
      properties:
        reg: false
    else:
      required:
        - reg

  - if:
      properties:
        compatible:
          contains:
            const: microchip,miv-ihc-rtl-v2
    then:
      properties:
        interrupt-names:
          items:
            pattern: "^hart-[0-5]+$"

examples:
  - |
    mailbox {
      compatible = "microchip,sbi-ipc";
      interrupt-parent = <&plic>;
      interrupts = <180>, <179>, <178>;
      interrupt-names = "hart-1", "hart-2", "hart-3";
      #mbox-cells = <1>;
    };
  - |
    mailbox@50000000 {
      compatible = "microchip,miv-ihc-rtl-v2";
      reg = <0x50000000 0x1C000>;
      interrupt-parent = <&plic>;
      interrupts = <180>, <179>, <178>;
      interrupt-names = "hart-1", "hart-2", "hart-3";
      #mbox-cells = <1>;
    };
```
